## meta-add-ons/conf/layer.conf
```bitbake
# We have a conf and classes directory, append to BBPATH
BBPATH .= ":${LAYERDIR}"

# We have a recipes directory containing .bb and .bbappend files, add to BBFILES
BBFILES += "${LAYERDIR}/recipes*/*/*.bb \
            ${LAYERDIR}/recipes*/*/*.bbappend"

BBFILE_COLLECTIONS += "compulab-add-ons"
BBFILE_PATTERN_compulab-add-ons := "^${LAYERDIR}/"
BBFILE_PRIORITY_compulab-add-ons = "9"
```

## meta-bsp-imx6ul/conf/layer.conf
```bitbake
# We have a conf and classes directory, append to BBPATH
BBPATH .= ":${LAYERDIR}"

# We have a recipes directory containing .bb and .bbappend files, add to BBFILES
BBFILES += "${LAYERDIR}/recipes-*/*/*.bb \
            ${LAYERDIR}/recipes-*/*/*.bbappend"

BBFILE_COLLECTIONS += "compulab-bsp-imx6ul"
BBFILE_PATTERN_compulab-bsp-imx6ul := "^${LAYERDIR}/"
BBFILE_PRIORITY_compulab-bsp-imx6ul = "9"
```

## meta-bsp-imx7/conf/layer.conf
```bitbake
# We have a conf and classes directory, append to BBPATH
BBPATH .= ":${LAYERDIR}"

# We have a recipes directory containing .bb and .bbappend files, add to BBFILES
BBFILES += "${LAYERDIR}/recipes-*/*/*.bb \
            ${LAYERDIR}/recipes-*/*/*.bbappend"

BBFILE_COLLECTIONS += "compulab-bsp-imx7"
BBFILE_PATTERN_compulab-bsp-imx7 := "^${LAYERDIR}/"
BBFILE_PRIORITY_compulab-bsp-imx7 = "9"
```

## meta-bsp/conf/machine/ucm-imx8.conf
```bitbake
#@TYPE: Machine
#@NAME: CompuLab UCM i.MX8MQ Evaluation Kit
#@SOC: i.MX8MQ
#@DESCRIPTION: Machine configuration for CompuLab UCM i.MX8MQ EVK
#@MAINTAINER: CompuLab <compulab@compulab.com>

require conf/machine/include/arm/arch-arm64.inc
require conf/machine/include/imx-base.inc

MACHINEOVERRIDES =. "mx8:mx8mq:"

PREFERRED_PROVIDER_virtual/bootloader_ucm-imx8 = "u-boot-imx"

MACHINE_FEATURES += " pci wifi bluetooth optee"
MACHINE_SOCARCH_FILTER_append_ucm-imx8 = "virtual/libopenvg virtual/libgles1 virtual/libgles2 virtual/egl virtual/mesa virtual/libgl virtual/libg2d"

KERNEL_DEVICETREE = "compulab/ucm-imx8.dtb"
KERNEL_DEVICETREE += "compulab/sbc-ucm-imx8.dtb"
KERNEL_DEVICETREE += "compulab/sbc-ucm-imx8-sd-card.dtb"
KERNEL_DEVICETREE += "compulab/sbc-ucm-imx8-lvds-dcss.dtb"
KERNEL_DEVICETREE += "compulab/sbc-ucm-imx8-lvds-lcdif.dtb"

UBOOT_CONFIG ??= "sd"
UBOOT_CONFIG[sd] = "ucm-imx8_defconfig,sdcard"
UBOOT_CONFIG[mfgtool] = "ucm-imx8_defconfig"
SPL_BINARY = "spl/u-boot-spl.bin"

# Set DDR FIRMWARE
DDR_FIRMWARE_NAME = "lpddr4_pmu_train_1d_imem.bin lpddr4_pmu_train_1d_dmem.bin lpddr4_pmu_train_2d_imem.bin lpddr4_pmu_train_2d_dmem.bin"

# Set u-boot DTB
UBOOT_DTB_NAME = "ucm-imx8.dtb"

# Set imx-mkimage boot target
IMXBOOT_TARGETS = "flash_evk flash_evk_no_hdmi"

# Set Serial console
SERIAL_CONSOLE = "115200 ttymxc2"

IMAGE_BOOTLOADER = "imx-boot"

SDCARD_GENERATION_COMMAND_ucm-imx8 = "generate_imx_sdcard"

DEFAULTTUNE_ucm-imx8 = "aarch64"

IMX_DEFAULT_KERNEL_ucm-imx8 = "linux-imx"

BOOT_SPACE = "32768"

KERNEL_IMAGETYPE = "Image"
LOADADDR = ""
UBOOT_SUFFIX = "bin"
UBOOT_MAKE_TARGET = ""
IMX_BOOT_SEEK = "33"

IMAGE_FSTYPES = "sdcard.xz tar.xz"
```

## meta-devtool/conf/layer.conf
```bitbake
# We have a conf and classes directory, append to BBPATH
BBPATH .= ":${LAYERDIR}"

# We have a recipes directory containing .bb and .bbappend files, add to BBFILES
BBFILES += "${LAYERDIR}/recipes*/*/*.bb \
            ${LAYERDIR}/recipes*/*/*.bbappend"

BBFILE_COLLECTIONS += "compulab-devtool"
BBFILE_PATTERN_compulab-devtool := "^${LAYERDIR}/"
BBFILE_PRIORITY_compulab-devtool = "9"

LAYERSERIES_COMPAT_compulab-devtool = "sumo warrior thud zeus dunfell gatesgarth hardknott honister"

HOSTTOOLS += "tree"
```

## meta-gnome/conf/layer.conf
```bitbake
# We have a conf and classes directory, append to BBPATH
BBPATH .= ":${LAYERDIR}"

# We have a recipes directory containing .bb and .bbappend files, add to BBFILES
BBFILES += "${LAYERDIR}/recipes*/*/*.bb \
            ${LAYERDIR}/recipes*/*/*.bbappend"

BBFILE_COLLECTIONS += "compulab-gnome"
BBFILE_PATTERN_compulab-gnome := "^${LAYERDIR}/"
BBFILE_PRIORITY_compulab-gnome = "9"

LAYERSERIES_COMPAT_compulab-gnome = "sumo warrior zeus dunfell gatesgarth honister kirkstone"

DISTRO_FEATURES:append = " pam polkit"
```

## meta-graphics/conf/layer.conf
```bitbake
# We have a conf and classes directory, append to BBPATH
BBPATH .= ":${LAYERDIR}"

# We have a recipes directory containing .bb and .bbappend files, add to BBFILES
BBFILES += "${LAYERDIR}/recipes*/*/*.bb \
            ${LAYERDIR}/recipes*/*/*.bbappend"

BBFILE_COLLECTIONS += "compulab-graphics"
BBFILE_PATTERN_compulab-graphics := "^${LAYERDIR}/"
BBFILE_PRIORITY_compulab-graphics = "9"

LAYERSERIES_COMPAT_compulab-graphics = "zeus dunfell gatesgarth hardknott"
```

## meta-net/conf/layer.conf
```bitbake
# We have a conf and classes directory, append to BBPATH
BBPATH .= ":${LAYERDIR}"

# We have a recipes directory containing .bb and .bbappend files, add to BBFILES
BBFILES += "${LAYERDIR}/recipes-*/*/*.bb \
            ${LAYERDIR}/recipes-*/*/*.bbappend"

BBFILE_COLLECTIONS += "compulab-net"
BBFILE_PATTERN_compulab-net := "^${LAYERDIR}/"
BBFILE_PRIORITY_compulab-net = "9"

BBMASK += "${@bb.utils.contains('DISTRO_CODENAME', 'hardknott',  '',	'meta-compulab-bsp/meta-net', d)}"
BBMASK += "${@bb.utils.contains('DISTRO_CODENAME', 'kirkstone',  '',	'meta-compulab-bsp/meta-net', d)}"

LAYERSERIES_COMPAT_compulab-net = "mickledore sumo warrior thud zeus gatesgarth hardknott honister kirkstone"
```

## meta-sdk/conf/layer.conf
```bitbake
# We have a conf and classes directory, append to BBPATH
BBPATH .= ":${LAYERDIR}"

# We have a recipes directory containing .bb and .bbappend files, add to BBFILES
BBFILES += "${LAYERDIR}/recipes-*/*/*.bb \
            ${LAYERDIR}/recipes-*/*/*.bbappend"

BBFILE_COLLECTIONS += "compulab-sdk"
BBFILE_PATTERN_compulab-sdk := "^${LAYERDIR}/"
BBFILE_PRIORITY_compulab-sdk = "9"

LAYERSERIES_COMPAT_compulab-sdk = "mickledore gatesgarth hardknott honister kirkstone"
```

## meta-utils/conf/layer.conf
```bitbake
# We have a conf and classes directory, append to BBPATH
BBPATH .= ":${LAYERDIR}"

# We have a recipes directory containing .bb and .bbappend files, add to BBFILES
BBFILES += "${LAYERDIR}/recipes*/*/*.bb \
            ${LAYERDIR}/recipes*/*/*.bbappend"

BBFILE_COLLECTIONS += "compulab-utils"
BBFILE_PATTERN_compulab-utils := "^${LAYERDIR}/"
BBFILE_PRIORITY_compulab-utils = "9"

LAYERSERIES_COMPAT_compulab-utils = "mickledore sumo warrior thud zeus dunfell gatesgarth hardknott honister kirkstone"

# codeaurora
BBMASK += "mp-verification-tool.bb"
BBMASK += "keyctl-caam.bb"
```
